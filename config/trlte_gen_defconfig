## config/trlte_gen_defconfig
```kconfig
# TCP Congestion Control
CONFIG_TCP_CONG_ADVANCED=y
CONFIG_TCP_CONG_BIC=y
CONFIG_TCP_CONG_HSTCP=y
CONFIG_TCP_CONG_HYBLA=y
CONFIG_TCP_CONG_VEGAS=y
CONFIG_TCP_CONG_WESTWOOD=y
CONFIG_TCP_CONG_VENO=y
CONFIG_TCP_CONG_RENO=y
CONFIG_TCP_CONG_ILLINOIS=y
CONFIG_TCP_CONG_SCALABLE=y
CONFIG_TCP_CONG_LP=y
CONFIG_TCP_CONG_YEAH=y
CONFIG_TCP_CONG_ILLINOIS=y
CONFIG_DEFAULT_WESTWOOD=y
CONFIG_DEFAULT_TCP_CONG="westwood"

# CPU Governors
CONFIG_CPU_FREQ_GOV_DANCEDANCE=y
CONFIG_CPU_FREQ_GOV_LIONHEART=y
CONFIG_CPU_FREQ_GOV_SMARTMAX=y
CONFIG_CPU_FREQ_GOV_YANKACTIVE=y

# IO Schedulers
CONFIG_IOSCHED_SIO=y
CONFIG_IOSCHED_FIFO=y
CONFIG_IOSCHED_ZEN=y
CONFIG_IOSCHED_VR=y

# RAM Console
CONFIG_ANDROID_PERSISTENT_RAM=y
CONFIG_ANDROID_RAM_CONSOLE=y

# CPU
CONFIG_INTELLI_THERMAL=y
# CONFIG_CPUFREQ_HARDLIMIT is not set
CONFIG_CPU_VOLTAGE_TABLE=y
CONFIG_INTELLI_PLUG=y

# GPU
CONFIG_SIMPLE_GPU_ALGORITHM=y

# Battery
CONFIG_FORCE_FAST_CHARGE=y

# Power
CONFIG_POWERSUSPEND=y
CONFIG_POWER_SUSPEND_DEBUG=y

# Touchscreen
CONFIG_TOUCHSCREEN_SWEEP2WAKE=y

# Filesystem
CONFIG_DYNAMIC_FSYNC=y

# Audio
CONFIG_SLIMBUS_BOOST=y
```

## config/trlte_plz_defconfig
```kconfig
CONFIG_SEC_TRLTE_PROJECT=y
CONFIG_MACH_TRLTE_TMO=y
#
# MAX77828 IC
#
CONFIG_EXTCON=y
CONFIG_EXTCON_MAX77828=y
CONFIG_MFD_MAX77828=y
CONFIG_EXTCON_MAX77843=y
CONFIG_MFD_MAX77843=y
CONFIG_MUIC_SUPPORT_HMT_DETECTION=y
CONFIG_MUIC_SUPPORT_DESK_DOCK=y
CONFIG_MUIC_SUPPORT_SMART_DOCK=y
CONFIG_MUIC_SUPPORT_QC_CHARGER=y
CONFIG_MOTOR_DRV_MAX77828=y
CONFIG_MOTOR_DRV_MAX77843=y
CONFIG_TACTILE_ASSIST=y
CONFIG_VIBETONZ=y
CONFIG_LEDS_MAX77828=y
#
# GPIO EXPANDER
#
CONFIG_GPIO_PCAL6416A=y
#
# IDCHIP
#
#CONFIG_INPUT_HALLIC=y
CONFIG_SENSORS_HALL=y
CONFIG_W1=y
CONFIG_W1_MASTER_GPIO_MSM=y
CONFIG_W1_SLAVE_DS28EL35=y
CONFIG_W1_WORKQUEUE=y
CONFIG_W1_FAST_CHECK=y
CONFIG_W1_SN=y
#
# Battery & Charger
#
# CONFIG_SMB350_CHARGER is not set
# CONFIG_BATTERY_BQ28400 is not set
# CONFIG_BATTERY_MSM is not set
# CONFIG_FUELGAUGE_DUMMY is not set
#
# MAX77823 Charger
#
# CONFIG_QPNP_CHARGER is not set
# CONFIG_QPNP_BMS is not set
CONFIG_MFD_MAX77823=y
CONFIG_FUELGAUGE_MAX77823=y
CONFIG_FUELGAUGE_MAX77823_COULOMB_COUNTING=y
CONFIG_CHARGER_MAX77823=y
CONFIG_FUELGAUGE_MAX77843=y
CONFIG_CHARGER_MAX77843=y
CONFIG_SAMSUNG_LPM_MODE=y
CONFIG_BATTERY_SAMSUNG=y
CONFIG_BATTERY_SAMSUNG_DATA_FILE="tr_battery_data.h"
#
# NFC
#
# CONFIG_NFC_DUAL is not set
# CONFIG_SEC_NFC_I2C is not set
# CONFIG_SEC_NFC is not set
# CONFIG_SEC_NFC_PRODUCT_N5 is not set
# CONFIG_NFC_N5_8084_USE_BBCLK2 is not set
# CONFIG_SEC_NFC_MARGINTIME is not set
# CONFIG_NFC_PN547 is not set
# CONFIG_NFC_PN547_8084_USE_BBCLK2 is not set
#
# LCD PANEL INFO
#
CONFIG_FB_MSM_MIPI_SAMSUNG_OCTA_S6E3HA2_CMD_WQHD_PT_PANEL=y
CONFIG_FB_MSM_CMD_MODE_PANEL=y
CONFIG_FB_MSM_DUAL_DSI_MODE=y
CONFIG_FB_MSM_MDSS_DSI_DBG=y
CONFIG_LCD_HMT=y
#
# TSP,Tkey,Wacom
#
# CONFIG_TOUCHSCREEN_SYNAPTICS_I2C_RMI_G is not set
CONFIG_TOUCHSCREEN_STM=y
CONFIG_KEYBOARD_CYPRESS_TOUCHKEY_T=y
CONFIG_INPUT_WACOM=y
CONFIG_INPUT_BOOSTER=y
CONFIG_WACOM_LCD_FREQ_COMPENSATE=y
#
# Finger print sensor
#
# CONFIG_SENSORS_FINGERPRINT is not set
# CONFIG_SENSORS_FINGERPRINT_SYSFS is not set
# CONFIG_SENSORS_VFS61XX is not set
# CONFIG_SENSORS_VFS61XX_KO is not set

# SensorHub
CONFIG_SENSORS_SSP=y
CONFIG_SENSORS_SYSFS=y
CONFIG_SENSORS_SSP_ATMEL=y
CONFIG_SENSORS_SSP_SENSORHUB=y
CONFIG_SENSORS_SSP_FACTORY=y
CONFIG_SENSORS_SSP_ICM20610=y
CONFIG_SENSORS_SSP_LPS25H=y
CONFIG_SENSORS_SSP_AK09911C=y
CONFIG_SENSORS_SSP_TMG399X=y
CONFIG_SENSORS_SSP_MOBEAM=y
CONFIG_SENSORS_SSP_ATUC128L5HAR=y
CONFIG_SENSORS_SSP_DIRECTION_EXCEPTION=y
CONFIG_IIO=y
CONFIG_IIO_BUFFER=y
CONFIG_IIO_KFIFO_BUF=y
CONFIG_IIO_TRIGGER=y

# Hrm Sensor + UV sensor
# CONFIG_SENSORS_MAX86902 is not set
# CONFIG_SENSORS_MAX_NOTCHFILTER is not set
# CONFIG_SENSORS_ADPD142 is not set
# CONFIG_AVERAGE is not set

#
# CAMERA
#
# CONFIG_S5K2P2XX is not set
# CONFIG_COMPANION is not set
# CONFIG_OIS is not set
# CONFIG_LEDS_MAX77828 is not set
# CONFIG_LEDS_MIC2873 is not set
# CONFIG_DEBUG_FLASH is not set

CONFIG_LEDS_MAX77828_RGB=y
CONFIG_LEDS_MAX77843_RGB=y
#CONFIG IR LED
CONFIG_SEC_FPGA_ICE40XX=y

# Earjack
# CONFIG_SAMSUNG_JACK is not set
# CONFIG_INPUT_GPIO is not set

# MHL
CONFIG_SEC_MHL_SII8620=y

CONFIG_CRYPTO_NULL=y

# SUB PMIC
CONFIG_REGULATOR_MAX77826=y
CONFIG_REGULATOR_S2MPB01=y

# SSWAP
# CONFIG_SWAP is not set
# CONFIG_FRONTSWAP is not set
# CONFIG_ZSMALLOC_NEW is not set
# CONFIG_PGTABLE_MAPPING is not set
# CONFIG_ZSWAP is not set
# CONFIG_DIRECT_RECLAIM_FILE_PAGES_ONLY is not set
# CONFIG_INCREASE_MAXIMUM_SWAPPINESS is not set
# CONFIG_FIX_INACTIVE_RATIO is not set
# CONFIG_TIGHT_PGDAT_BALANCE is not set
# CONFIG_VNSWAP is not set
# CONFIG_SWAP_ENABLE_READAHEAD is not set
# DSM Solution
CONFIG_SND_SOC_MAX98504=y
CONFIG_SND_SOC_MAXIM_DSM=y
#3MIC
CONFIG_SND_SOC_3MIC_SUPPORT=y
# VEQ
CONFIG_SND_SOC_VEQ_SUPPORT=y

#EPDG
CONFIG_NET_CORE=y
CONFIG_NET_SCH_PRIO=y
CONFIG_NET_SCHED=y   #depends on CONFIG_NET  which is enabled by default.. coz not seeing in the config file
CONFIG_NET_CLS_BASIC=y # required if basic is being used as a filter. depends on CONFIG_NET_CLS so enabling it by default
CONFIG_NET_CLS=y
CONFIG_NET_CLS_ACT=y # for enabling the action target.
CONFIG_NET_ACT_MIRRED=y  # for enabling the mirred target for redirecting the packet between the devices.
CONFIG_NET_EMATCH=y   #basic uses extended matches so this has to be present
CONFIG_NET_SCH_INGRESS=y # classifier for ingress packet

# Wifi features
CONFIG_WLAN_REGION_CODE=402

CONFIG_CPU_FREQ_LIMIT=y
CONFIG_CPU_FREQ_LIMIT_USERSPACE=y

CONFIG_RECOVERY_KERNEL=y
```

## config/trlte_sku_defconfig
```kconfig
CONFIG_LOCALVERSION="-Trophaeum"

# TCP Congestion Control
CONFIG_TCP_CONG_ADVANCED=y
CONFIG_TCP_CONG_BIC=y
CONFIG_TCP_CONG_HSTCP=y
CONFIG_TCP_CONG_HYBLA=y
CONFIG_TCP_CONG_VEGAS=y
CONFIG_TCP_CONG_WESTWOOD=y
CONFIG_TCP_CONG_VENO=y
CONFIG_TCP_CONG_RENO=y
CONFIG_TCP_CONG_ILLINOIS=y
CONFIG_TCP_CONG_SCALABLE=y
CONFIG_TCP_CONG_LP=y
CONFIG_TCP_CONG_YEAH=y
CONFIG_TCP_CONG_ILLINOIS=y
CONFIG_DEFAULT_HSTCP=y
CONFIG_DEFAULT_TCP_CONG="highspeed"

# CPU Governors
CONFIG_CPU_FREQ_GOV_DANCEDANCE=y
CONFIG_CPU_FREQ_GOV_LIONHEART=y
CONFIG_CPU_FREQ_GOV_SMARTMAX=y
CONFIG_CPU_FREQ_GOV_INTELLIDEMAND=y
CONFIG_CPU_FREQ_GOV_SMARTASS2=y
CONFIG_CPU_FREQ_GOV_UMBRELLA_CORE=y
CONFIG_CPU_FREQ_GOV_BIOSHOCK=y
# CONFIG_CPU_FREQ_GOV_RACCOON_CITY is not set

# IO Schedulers
CONFIG_IOSCHED_SIO=y
CONFIG_IOSCHED_FIFO=y
CONFIG_IOSCHED_ZEN=y
CONFIG_IOSCHED_VR=y
CONFIG_IOSCHED_FIOPS=y
CONFIG_IOSCHED_CFQ=y
CONFIG_DEFAULT_CFQ=y

# CPU
CONFIG_CPU_VOLTAGE_TABLE=y
# CONFIG_CPU_FREQ_LIMIT is not set
# CONFIG_MSM_CPUFREQ_LIMIT is not set 
CONFIG_CPUFREQ_HARDLIMIT=y

# Thermal
# CONFIG_THERMAL_MONITOR is not set
CONFIG_INTELLI_THERMAL=y
# CONFIG_INTELLI_THERMAL_V2 is not set

# Hotplug
CONFIG_INTELLI_PLUG=y

# GPU
CONFIG_SIMPLE_GPU_ALGORITHM=y

# Battery
CONFIG_FORCE_FAST_CHARGE=y

# Power Management
CONFIG_POWERSUSPEND=y
# CONFIG_POWER_SUSPEND_DEBUG is not set

# Touchscreen
CONFIG_TOUCHSCREEN_SWEEP2WAKE=y

# Filesystem
CONFIG_DYNAMIC_FSYNC=y
CONFIG_F2FS_FS=y
CONFIG_F2FS_STAT_FS=y
CONFIG_F2FS_FS_XATTR=y
CONFIG_F2FS_FS_POSIX_ACL=y
CONFIG_CIFS=y
CONFIG_CIFS_WEAK_PW_HASH=y

# Audio
CONFIG_SLIMBUS_BOOST=y
# CONFIG_SOUND_CONTROL_HAX_3_GPL is not set

# Color
CONFIG_MDNIE_LITE_CONTROL=y

# SELinux
CONFIG_SECURITY_SELINUX_DEVELOP=y

# Memory
CONFIG_HAS_MACH_MEMUTILS=y

# IPV6
CONFIG_IPV6_USE_OPTIMISTIC=y

# Logo
CONFIG_LOGO_SKU_CLUT224=y
```
